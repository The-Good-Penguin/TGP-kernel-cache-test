## meta-caching/conf/layer.conf
```bitbake
# We have a conf and classes directory, add to BBPATH
BBPATH =. "${LAYERDIR}:"

# We have recipes-* directories, add to BBFILES
BBFILES += "${LAYERDIR}/recipes-*/*/*.bb \
            ${LAYERDIR}/recipes-*/*/*.bbappend"

BBFILE_COLLECTIONS += "caching"
BBFILE_PATTERN_caching = "^${LAYERDIR}/"
BBFILE_PRIORITY_caching = "10"

LAYERSERIES_COMPAT_caching = "kirkstone"

LAYERDEPENDS_caching = "core"

REQUIRED_POKY_BBLAYERS_CONF_VERSION = "2"

# Set a variable to get to the top of the metadata location
CACHINGBASE = '${@os.path.normpath("${LAYERDIR}/../")}'
```

## meta-caching/wic/qemu-grub.wks
```
# This is an example of a simple wic file for grub
# The boot partition is the EFI system partition
# The rootfs partition is the main filesystem
part --source bootimg-efi --sourceparams="loader=grub-efi" --ondisk vda --fstype=vfat --label=boot --active --align 1024
part --source rootfs --ondisk vda --fstype=ext4 --label=root --align 1024

bootloader --timeout=5 --append="root=/dev/vda2 rw" --ptable gpt
```

## meta-caching/wic/qemu-uboot.wks
```
# short-description: U-Boot image for QEMU arm64
# long-description: Creates a partitioned image for QEMU ARM64 with U-Boot

# Partition for U-Boot raw copy. This is a special, unformatted partition
# where the bootloader is placed at a specific offset.
part --source rawcopy --sourceparams="file=u-boot-qemuarm64.bin" --ondisk vda --no-table --align 128

# The boot partition. This will hold the kernel image and device tree blob (dtb).
# It's a FAT filesystem that U-Boot can read.
part --source bootimg-partition --ondisk vda --fstype=vfat --label=boot --active --align 1024

# The root filesystem partition.
part --source rootfs --ondisk vda --fstype=ext4 --label rootfs --align 1024

# The bootloader section of the wks file.
# We don't need a specific bootloader command as U-Boot handles this
# directly from the `boot` partition.
```
